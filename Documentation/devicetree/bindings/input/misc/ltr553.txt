## Documentation/devicetree/bindings/input/misc/ltr553.txt
```
Liteon ltr553 L/P sensor

Required properties:

 - compatible		: Should be "liteon,ltr553".
 - reg				: i2c slave address of the device.
 - interrupt-parent	: Parent of interrupt.
 - interrupts		: L/P sample interrupt to indicate new data ready.
 - liteon,intr		: The gpio pin for the interrupt.
 - liteon,highthr	: The threshold adc value for proximity sensor to trigger close  interrupt.
 - liteon,lowthr	: The threshold adc value for proximity sensor to trigger away interrupt.

Example:
	&i2c_0 { /* BLSP1 QUP2 */
		liteon@23 {
			compatible = "liteon,ltr553";
			reg = <0x23>;
			pinctrl-names = "default";
			pinctrl-0 = <&ltr553_default>;
			interrupt-parent = <&msm_gpio>;
			interrupts = <113 0x2>;
			liteon,intr = <&msm_gpio 113 0x2>;
			liteon,highthr = <800>;
			liteon,lowthr = <300>;
		};
	};
```

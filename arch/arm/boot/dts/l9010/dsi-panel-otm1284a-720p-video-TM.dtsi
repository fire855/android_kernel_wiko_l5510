/* Copyright (c) 2013, The Linux Foundation. All rights reserved.
 *
 * This program is free software; you can redistribute it and/or modify
 * it under the terms of the GNU General Public License version 2 and
 * only version 2 as published by the Free Software Foundation.
 *
 * This program is distributed in the hope that it will be useful,
 * but WITHOUT ANY WARRANTY; without even the implied warranty of
 * MERCHANTABILITY or FITNESS FOR A PARTICULAR PURPOSE.  See the
 * GNU General Public License for more details.
 */

/*---------------------------------------------------------------------------
 * This file is autogenerated file using gcdb parser. Please do not edit it.
 * Update input XML file to add a new entry or update variable in this file
 * VERSION = "1.0"
 *---------------------------------------------------------------------------*/
&mdss_mdp {
	dsi_otm1284a_720p_video_tm: qcom,mdss_dsi_otm1284a_720p_video_tm {
		qcom,mdss-dsi-panel-name = "otm1284a 720p video TM mode dsi panel";
		qcom,mdss-dsi-panel-controller = <&mdss_dsi0>;
		qcom,mdss-dsi-panel-type = "dsi_video_mode";
		qcom,mdss-dsi-panel-destination = "display_1";
		qcom,mdss-dsi-panel-framerate = <60>;
		qcom,mdss-dsi-virtual-channel-id = <0>;
		qcom,mdss-dsi-stream = <0>;
		qcom,mdss-dsi-panel-width = <720>;
		qcom,mdss-dsi-panel-height = <1280>;
		qcom,mdss-dsi-h-front-porch = <44>;
		qcom,mdss-dsi-h-back-porch = <42>;
		qcom,mdss-dsi-h-pulse-width = <2>;
		qcom,mdss-dsi-h-sync-skew = <0>;
		qcom,mdss-dsi-v-back-porch = <14>;
		qcom,mdss-dsi-v-front-porch = <16>;
		qcom,mdss-dsi-v-pulse-width = <2>;
		qcom,mdss-dsi-h-left-border = <0>;
		qcom,mdss-dsi-h-right-border = <0>;
		qcom,mdss-dsi-v-top-border = <0>;
		qcom,mdss-dsi-v-bottom-border = <0>;
		qcom,mdss-dsi-bpp = <24>;
		qcom,mdss-dsi-color-order = "rgb_swap_rgb";
		qcom,mdss-dsi-underflow-color = <0xff>;
		qcom,mdss-dsi-border-color = <0>;
		qcom,mdss-dsi-on-command = [39 01 00 00 00 00 02 00 00
		39 01 00 00 00 00 04 ff 12 84 01
		39 01 00 00 00 00 02 00 80
		39 01 00 00 00 00 03 ff 12 84
		39 01 00 00 00 00 02 00 92
		39 01 00 00 00 00 03 ff 30 02
		39 01 00 00 00 00 02 00 80 
		39 01 00 00 00 00 0A C0 00 64 00 0E 12 00 64 0E 12
		39 01 00 00 00 00 02 00 B4  
		39 01 00 00 00 00 02 C0 55
		39 01 00 00 00 00 02 00 80  
		39 01 00 00 00 00 02 C4 30
		39 01 00 00 00 00 02 00 81  
		39 01 00 00 00 00 02 C4 87
		39 01 00 00 00 00 02 00 8A
		39 01 00 00 00 00 02 C4 40
		39 01 00 00 00 00 02 00 81
		39 01 00 00 00 00 02 c1 66
		39 01 00 00 00 00 02 00 a0
		39 01 00 00 00 00 02 c1 02
		39 01 00 00 00 00 02 00 82   
		39 01 00 00 00 00 02 C4 0a
		39 01 00 00 00 00 02 00 C6   
		39 01 00 00 00 00 02 B0 03
		39 01 00 00 00 00 02 00 c2
		39 01 00 00 00 00 02 f5 40
		39 01 00 00 00 00 02 00 c3
		39 01 00 00 00 00 02 f5 85
		39 01 00 00 00 00 02 00 87
		39 01 00 00 00 00 02 c4 18
		39 01 00 00 00 00 02 00 a0
		39 01 00 00 00 00 0F c4 05 10 06 02 05 15 10 05 10 07 02 05 15 10
		39 01 00 00 00 00 02 00 b0
		39 01 00 00 00 00 03 c4 00 00
		39 01 00 00 00 00 02 00 bb
		39 01 00 00 00 00 02 c5 8a
		39 01 00 00 00 00 02 00 91
		39 01 00 00 00 00 03 c5 16 52
		39 01 00 00 00 00 02 00 00
		39 01 00 00 00 00 03 d8 aa aa
		39 01 00 00 00 00 02 00 00
		39 01 00 00 00 00 02 d9 77
		39 01 00 00 00 00 02 00 b3
		39 01 00 00 00 00 02 c5 84
		39 01 00 00 00 00 02 00 90
		39 01 00 00 00 00 05 f5 02 11 02 15
		39 01 00 00 00 00 02 00 90
		39 01 00 00 00 00 02 c5 50
		39 01 00 00 00 00 02 00 94 
		39 01 00 00 00 00 02 c5 66
		39 01 00 00 00 00 02 00 b2 
		39 01 00 00 00 00 03 f5 00 00
		39 01 00 00 00 00 02 00 b4 
		39 01 00 00 00 00 03 f5 00 00
		39 01 00 00 00 00 02 00 b6 
		39 01 00 00 00 00 03 f5 00 00
		39 01 00 00 00 00 02 00 b8 
		39 01 00 00 00 00 03 f5 00 00
		39 01 00 00 00 00 02 00 94
		39 01 00 00 00 00 03 f5 00 00
		39 01 00 00 00 00 02 00 d2
		39 01 00 00 00 00 03 f5 06 15
		39 01 00 00 00 00 02 00 b4
		39 01 00 00 00 00 02 c5 CC
		39 01 00 00 00 00 02 00 80
		39 01 00 00 00 00 0C cb 00 00 00 00 00 00 00 00 00 00 00
		39 01 00 00 00 00 02 00 90 
		39 01 00 00 00 00 10 cb 00 00 00 00 00 00 00 00 00 00 00 00 00 00 00
		39 01 00 00 00 00 02 00 A0
		39 01 00 00 00 00 10 cb 00 00 00 00 00 00 00 00 00 00 00 00 00 00 00
		39 01 00 00 00 00 02 00 B0
		39 01 00 00 00 00 10 cb 00 00 00 00 00 00 00 00 00 00 00 00 00 00 00
		39 01 00 00 00 00 02 00 c0
		39 01 00 00 00 00 10 cb 05 05 05 05 05 05 00 00 00 00 00 00 00 00 00
		39 01 00 00 00 00 02 00 d0
		39 01 00 00 00 00 10 cb 00 00 00 00 05 05 05 05 05 05 05 05 05 00 00
		39 01 00 00 00 00 02 00 e0
		39 01 00 00 00 00 0F cb 00 00 00 00 00 00 00 00 00 00 00 05 05 05
		39 01 00 00 00 00 02 00 f0
		39 01 00 00 00 00 0C cb ff ff ff ff ff ff ff fc ff ff ff
		39 01 00 00 00 00 02 00 80
		39 01 00 00 00 00 10 cc 0c 0a 10 0e 02 04 00 00 00 00 00 00 00 00 00
		39 01 00 00 00 00 02 00 90
		39 01 00 00 00 00 10 cc 00 00 00 00 06 2e 2d 0b 09 0f 0d 01 03 00 00
		39 01 00 00 00 00 02 00 a0
		39 01 00 00 00 00 0F cc 00 00 00 00 00 00 00 00 00 00 00 05 2e 2d
		39 01 00 00 00 00 02 00 b0
		39 01 00 00 00 00 10 cc 0d 0f 09 0b 03 01 00 00 00 00 00 00 00 00 00
		39 01 00 00 00 00 02 00 c0
		39 01 00 00 00 00 10 cc 00 00 00 00 06 2d 2e 0e 10 0a 0c 04 02 00 00
		39 01 00 00 00 00 02 00 d0
		39 01 00 00 00 00 0F cc 00 00 00 00 00 00 00 00 00 00 00 05 2d 2e
		39 01 00 00 00 00 02 00 80
		39 01 00 00 00 00 0D ce 8b 03 18 8a 03 18 89 03 18 88 03 18
		39 01 00 00 00 00 02 00 90
		39 01 00 00 00 00 0F ce 38 0f 18 38 0e 18 00 00 00 00 00 00 00 00   
		39 01 00 00 00 00 02 00 a0
		39 01 00 00 00 00 0F ce 38 07 05 00 00 18 00 38 06 05 01 00 18 00
		39 01 00 00 00 00 02 00 b0
		39 01 00 00 00 00 0F ce 38 05 05 02 00 18 00 38 04 05 03 00 18 00
		39 01 00 00 00 00 02 00 c0
		39 01 00 00 00 00 0F ce 38 03 05 04 00 18 00 38 02 05 05 00 18 00
		39 01 00 00 00 00 02 00 d0
		39 01 00 00 00 00 0F ce 38 01 05 06 00 18 00 38 00 05 07 00 18 00
		39 01 00 00 00 00 02 00 80
		39 01 00 00 00 00 0F cf 00 00 00 00 00 00 00 00 00 00 00 00 00 00
		39 01 00 00 00 00 02 00 90
		39 01 00 00 00 00 0F cf 00 00 00 00 00 00 00 00 00 00 00 00 00 00
		39 01 00 00 00 00 02 00 a0
		39 01 00 00 00 00 0F cf 00 00 00 00 00 00 00 00 00 00 00 00 00 00
		39 01 00 00 00 00 02 00 b0
		39 01 00 00 00 00 0F cf 00 00 00 00 00 00 00 00 00 00 00 00 00 00 
		39 01 00 00 00 00 02 00 c0
		39 01 00 00 00 00 0C cf 01 01 20 20 00 00 02 81 00 03 08
		39 01 00 00 00 00 02 00 b5
		39 01 00 00 00 00 07 c5 38 11 7f 38 11 7f
		39 01 00 00 00 00 02 00 00
		39 01 00 00 00 00 15 E1 03 1d 2d 3d 4d 5e 61 90 82 9d 65 4f 62 43 44 3a 30 28 23 10
		39 01 00 00 00 00 02 00 00
		39 01 00 00 00 00 15 E2 03 1d 2d 3d 4d 5e 61 90 82 9d 65 4f 62 43 44 3a 30 28 23 10
		//BEGIN <><20141025><modify for ESD>xiongdajun
              39 01 00 00 00 00 02 00 00
		39 01 00 00 00 00 04 ff ff ff ff
		//END <><20141025><modify for ESD>xiongdajun
		05 01 00 00 0a 00 02 35 00
		05 01 00 00 C8 00 02 11 00
		05 01 00 00 14 00 02 29 00];
		qcom,mdss-dsi-off-command = [29 01 00 00 96 00 02 28 00
					29 01 00 00 00 00 02 10 00];
		qcom,mdss-dsi-on-command-state = "dsi_lp_mode";
		qcom,mdss-dsi-off-command-state = "dsi_hs_mode";

		//BEGIN <><20141025><modify for ESD>xiongdajun
		qcom,mdss-dsi-panel-status-command = [06 01 00 01 05 00 02 0A 08];
		qcom,mdss-dsi-panel-status-command-state = "dsi_lp_mode";
		qcom,mdss-dsi-panel-status-check-mode = "reg_read";
		qcom,mdss-dsi-panel-status-value = <0x9c>;
		//qcom,mdss-dsi-panel-status-check-mode = "bta_check";
		//END <><20141025><modify for ESD>xiongdajun

                qcom,esd-check-enabled;
		qcom,mdss-dsi-h-sync-pulse = <1>;
		qcom,mdss-dsi-traffic-mode = "burst_mode";
		qcom,mdss-dsi-lane-map = "lane_map_0123";
		qcom,mdss-dsi-bllp-eof-power-mode;
		qcom,mdss-dsi-bllp-power-mode;
		qcom,mdss-dsi-lane-0-state;
		qcom,mdss-dsi-lane-1-state;
		qcom,mdss-dsi-lane-2-state;
		qcom,mdss-dsi-lane-3-state;
		qcom,mdss-dsi-panel-timings = [75 18 10 00 3A 3E 14 1A 13 03 04 00];
		qcom,mdss-dsi-t-clk-post = <0x2c>;
		qcom,mdss-dsi-t-clk-pre = <0x20>;
		qcom,mdss-dsi-bl-min-level = <1>;
		qcom,mdss-dsi-bl-max-level = <255>;
		qcom,mdss-dsi-dma-trigger = "trigger_sw";
		qcom,mdss-dsi-mdp-trigger = "none";
		qcom,mdss-dsi-bl-pmic-control-type = "bl_ctrl_gp_clk";//add by YangRujin for gp_clk control bl.
		//qcom,mdss-dsi-bl-pmic-control-type = "bl_ctrl_pwm";
		qcom,mdss-dsi-bl-pmic-pwm-frequency = <100>;
		qcom,mdss-dsi-bl-pmic-bank-select = <0>;
		qcom,mdss-dsi-pwm-gpio = <&pm8916_mpps 4 0>;
		//qcom,mdss-dsi-reset-sequence = <1 1>, <0 50>, <1 50>;
             qcom,mdss-dsi-lp11-init;
                //qcom,mdss-dsi-init-delay-us = <100>;
                qcom,mdss-dsi-reset-sequence = <1 20>, <0 20>, <1 50>;
                //qcom,mdss-dsi-hfp-power-mode;
                //qcom,mdss-dsi-hbp-power-mode;
                //qcom,mdss-dsi-hsa-power-mode;

	};
};

/* Copyright (c) 2013, The Linux Foundation. All rights reserved.
 *
 * This program is free software; you can redistribute it and/or modify
 * it under the terms of the GNU General Public License version 2 and
 * only version 2 as published by the Free Software Foundation.
 *
 * This program is distributed in the hope that it will be useful,
 * but WITHOUT ANY WARRANTY; without even the implied warranty of
 * MERCHANTABILITY or FITNESS FOR A PARTICULAR PURPOSE.  See the
 * GNU General Public License for more details.
 */

/*---------------------------------------------------------------------------
 * This file is autogenerated file using gcdb parser. Please do not edit it.
 * Update input XML file to add a new entry or update variable in this file
 * VERSION = "1.0"
 *---------------------------------------------------------------------------*/
&mdss_mdp {
	dsi_otm1284a_720p_video: qcom,mdss_dsi_otm1284a_720p_video {
		qcom,mdss-dsi-panel-name = "otm1284a 720p video mode dsi panel";
		qcom,mdss-dsi-panel-controller = <&mdss_dsi0>;
		qcom,mdss-dsi-panel-type = "dsi_video_mode";
		qcom,mdss-dsi-panel-destination = "display_1";
		qcom,mdss-dsi-panel-framerate = <60>;
		qcom,mdss-dsi-virtual-channel-id = <0>;
		qcom,mdss-dsi-stream = <0>;
		qcom,mdss-dsi-panel-width = <720>;
		qcom,mdss-dsi-panel-height = <1280>;
		qcom,mdss-dsi-h-front-porch = <44>;
		qcom,mdss-dsi-h-back-porch = <42>;
		qcom,mdss-dsi-h-pulse-width = <2>;
		qcom,mdss-dsi-h-sync-skew = <0>;
		qcom,mdss-dsi-v-back-porch = <14>;
		qcom,mdss-dsi-v-front-porch = <16>;
		qcom,mdss-dsi-v-pulse-width = <2>;
		qcom,mdss-dsi-h-left-border = <0>;
		qcom,mdss-dsi-h-right-border = <0>;
		qcom,mdss-dsi-v-top-border = <0>;
		qcom,mdss-dsi-v-bottom-border = <0>;
		qcom,mdss-dsi-bpp = <24>;
		qcom,mdss-dsi-color-order = "rgb_swap_rgb";
		qcom,mdss-dsi-underflow-color = <0xff>;
		qcom,mdss-dsi-border-color = <0>;
		qcom,mdss-dsi-on-command = [39 01 00 00 00 00 02 00 00
		39 01 00 00 00 00 04 FF 12 84 01
		39 01 00 00 00 00 02 00 80
		39 01 00 00 00 00 03 FF 12 84
		39 01 00 00 00 00 02 00 91
		39 01 00 00 00 00 02 B0 92
		39 01 00 00 00 00 02 00 80
		39 01 00 00 00 00 0A C0 00 64 00 0F 11 00 64 0F 11
		39 01 00 00 00 00 02 00 90 
		39 01 00 00 00 00 07 C0 00 5C 00 01 00 04
		39 01 00 00 00 00 02 00 A4 
		39 01 00 00 00 00 02 C0 00
		39 01 00 00 00 00 02 00 B3 
		39 01 00 00 00 00 03 C0 00 55
		39 01 00 00 00 00 02 00 81 
		39 01 00 00 00 00 02 C1 55 
		39 01 00 00 00 00 02 00 90 
		39 01 00 00 00 00 05 F5 02 11 02 15
		39 01 00 00 00 00 02 00 90 
		39 01 00 00 00 00 02 C5 50 
		39 01 00 00 00 00 02 00 94 
		39 01 00 00 00 00 02 C5 66 
		39 01 00 00 00 00 02 00 B2 
		39 01 00 00 00 00 03 F5 00 00
		39 01 00 00 00 00 02 00 B4 
		39 01 00 00 00 00 03 F5 15 11	//<Line><FFBAKK-105><20141118>update parameter of LCD;xiongdajun
		39 01 00 00 00 00 02 00 B6 
		39 01 00 00 00 00 03 F5 00 00
		39 01 00 00 00 00 02 00 B8 
		39 01 00 00 00 00 03 F5 15 11	//<Line><FFBAKK-105><20141118>update parameter of LCD;xiongdajun
		39 01 00 00 00 00 02 00 94 
		39 01 00 00 00 00 03 F5 00 00
		39 01 00 00 00 00 02 00 D2 
		39 01 00 00 00 00 03 F5 06 15
		39 01 00 00 00 00 02 00 B4 
		39 01 00 00 00 00 02 C5 CC
		39 01 00 00 00 00 02 00 A0
		39 01 00 00 00 00 0F C4 05 10 06 02 05 15 10 05 10 07 02 05 15 10
		39 01 00 00 00 00 02 00 B0 
		39 01 00 00 00 00 03 C4 00 00
		39 01 00 00 00 00 02 00 91 
		39 01 00 00 00 00 03 C5 19 52
		39 01 00 00 00 00 02 00 00 
		39 01 00 00 00 00 03 D8 BC BC
		39 01 00 00 00 00 02 00 B3 
		39 01 00 00 00 00 02 C5 84 
		39 01 00 00 00 00 02 00 BB 
		39 01 00 00 00 00 02 C5 8A 
		39 01 00 00 00 00 02 00 82 
		39 01 00 00 00 00 02 C4 0A 
		39 01 00 00 00 00 02 00 B2 
		39 01 00 00 00 00 02 C5 40 
		39 01 00 00 00 00 02 00 81 
		39 01 00 00 00 00 03 C4 82 0A
		39 01 00 00 00 00 02 00 C6 
		39 01 00 00 00 00 02 B0 03 
		39 01 00 00 00 00 02 00 C2 
		39 01 00 00 00 00 02 F5 40 
		39 01 00 00 00 00 02 00 C3 
		39 01 00 00 00 00 02 F5 85 
		39 01 00 00 00 00 02 00 00 
		39 01 00 00 00 00 15 E1 00 09 10 1B 27 36 38 68 59 78 8B 76 85 5D 55 47 35 20 10 00
		39 01 00 00 00 00 02 00 00 
		39 01 00 00 00 00 15 E2 00 09 10 1B 27 36 38 68 59 78 8b 76 85 5d 55 47 35 20 10 00
		39 01 00 00 00 00 02 00 80 
		39 01 00 00 00 00 0C CB 00 00 00 00 00 00 00 00 00 00 00
		39 01 00 00 00 00 02 00 90                                                 
		39 01 00 00 00 00 10 CB 00 00 00 00 00 00 00 00 00 00 00 00 00 00 00
		39 01 00 00 00 00 02 00 A0                                                                   
		39 01 00 00 00 00 10 CB 00 00 00 00 00 00 00 00 00 00 00 00 00 00 00
		39 01 00 00 00 00 02 00 B0                                                                   
		39 01 00 00 00 00 10 CB 00 00 00 00 00 00 00 00 00 00 00 00 00 00 00
		39 01 00 00 00 00 02 00 C0                                                                   
		39 01 00 00 00 00 10 CB 05 05 05 05 05 05 00 00 00 00 00 00 00 00 00
		39 01 00 00 00 00 02 00 D0                                                                   
		39 01 00 00 00 00 10 CB 00 00 00 00 00 05 05 05 05 05 05 05 05 00 00
		39 01 00 00 00 00 02 00 E0                                                                   
		39 01 00 00 00 00 0F CB 00 00 00 00 00 00 00 00 00 00 00 00 05 05
		39 01 00 00 00 00 02 00 F0                                                                   
		39 01 00 00 00 00 0C CB FF FF FF FF FF FF FF FF FF FF FF             
		39 01 00 00 00 00 02 00 80                                                                   
		39 01 00 00 00 00 10 CC 0A 0C 0E 10 02 04 00 00 00 00 00 00 00 00 00
		39 01 00 00 00 00 02 00 90                                                                               
		39 01 00 00 00 00 10 CC 00 00 00 00 00 2E 2D 09 0B 0D 0F 01 03 00 00
		39 01 00 00 00 00 02 00 A0                                                                               
		39 01 00 00 00 00 0F CC 00 00 00 00 00 00 00 00 00 00 00 00 2E 2D 
		39 01 00 00 00 00 02 00 B0                                                                               
		39 01 00 00 00 00 10 CC 0F 0D 0B 09 03 01 00 00 00 00 00 00 00 00 00
		39 01 00 00 00 00 02 00 C0                                                                               
		39 01 00 00 00 00 10 CC 00 00 00 00 00 2D 2E 10 0E 0C 0A 04 02 00 00
		39 01 00 00 00 00 02 00 D0                                                                         
		39 01 00 00 00 00 0F CC 00 00 00 00 00 00 00 00 00 00 00 00 2D 2E
		39 01 00 00 00 00 02 00 80                                                                         
		39 01 00 00 00 00 0D CE 8D 03 00 8C 03 00 8B 03 00 8A 03 00       
		39 01 00 00 00 00 02 00 90                                                                         
		39 01 00 00 00 00 0F CE 00 00 00 00 00 00 00 00 00 00 00 00 00 00
		39 01 00 00 00 00 02 00 A0                                                                         
		39 01 00 00 00 00 0F CE 38 0B 85 00 8D 03 00 38 0A 85 01 8D 03 00	//<Line><FFBAKK-105><20141118>update parameter of LCD;xiongdajun
		39 01 00 00 00 00 02 00 B0                                                                         
		39 01 00 00 00 00 0F CE 38 09 85 02 8D 03 00 38 08 85 03 8D 03 00	//<Line><FFBAKK-105><20141118>update parameter of LCD;xiongdajun
		39 01 00 00 00 00 02 00 C0                                                                         
		39 01 00 00 00 00 0F CE 38 07 85 04 8D 03 00 38 06 85 05 8D 03 00	//<Line><FFBAKK-105><20141118>update parameter of LCD;xiongdajun
		39 01 00 00 00 00 02 00 D0                                                                         
		39 01 00 00 00 00 0F CE 38 05 85 06 8D 03 00 38 04 85 07 8D 03 00	//<Line><FFBAKK-105><20141118>update parameter of LCD;xiongdajun
		39 01 00 00 00 00 02 00 80                                                                         
		39 01 00 00 00 00 0F CF 00 00 00 00 00 00 00 00 00 00 00 00 00 00
		39 01 00 00 00 00 02 00 90                                                                         
		39 01 00 00 00 00 0F CF 00 00 00 00 00 00 00 00 00 00 00 00 00 00
		39 01 00 00 00 00 02 00 A0                                                                         
		39 01 00 00 00 00 0F CF 00 00 00 00 00 00 00 00 00 00 00 00 00 00
		39 01 00 00 00 00 02 00 B0                                                                         
		39 01 00 00 00 00 0F CF 00 00 00 00 00 00 00 00 00 00 00 00 00 00
		39 01 00 00 00 00 02 00 C0                                                       
		39 01 00 00 00 00 0C CF 01 01 20 20 00 00 01 01 00 00 00
		39 01 00 00 00 00 02 00 B5                                                       
		39 01 00 00 00 00 07 C5 33 F1 FF 33 F1 FF
		39 01 00 00 00 00 02 00 92   // 92               ADD                                
		39 01 00 00 00 00 02 b3 06   //B3 06   ADD  
		39 01 00 00 00 00 02 00 90   // 92               ADD                                
		39 01 00 00 00 00 02 f6 00   //B3 06   ADD  
		39 01 00 00 00 00 02 00 a0   // 92               ADD                                
		39 01 00 00 00 00 02 c1 02   //B3 06   ADD  
		39 01 00 00 00 00 02 00 00                                                       
		39 01 00 00 00 00 04 FF FF FF FF                                                       
		39 01 00 00 00 00 02 00 00                                                       
		39 01 00 00 00 00 02 36 00                                                       
		05 01 00 00 96 00 02 11 00
		05 01 00 00 1E 00 02 29 00];
		qcom,mdss-dsi-off-command = [29 01 00 00 14 00 02 28 00
					29 01 00 00 78 00 02 10 00];
		qcom,mdss-dsi-on-command-state = "dsi_lp_mode";
		qcom,mdss-dsi-off-command-state = "dsi_lp_mode";
		//<BEGIN><><20141025><modify for ESD>xiongdajun
		qcom,mdss-dsi-panel-status-command = [06 01 00 01 05 00 02 ac 08];
		qcom,mdss-dsi-panel-status-command-state = "dsi_hs_mode";
		qcom,mdss-dsi-panel-status-check-mode = "reg_read";
		qcom,mdss-dsi-panel-status-value = <0x00>;
		//qcom,mdss-dsi-panel-status-check-mode = "bta_check";
		//<END><><20141025><modify for ESD>xiongdajun
                qcom,esd-check-enabled;
		qcom,mdss-dsi-h-sync-pulse = <1>;
		qcom,mdss-dsi-traffic-mode = "burst_mode";
		qcom,mdss-dsi-lane-map = "lane_map_0123";
		qcom,mdss-dsi-bllp-eof-power-mode;
		qcom,mdss-dsi-bllp-power-mode;
		qcom,mdss-dsi-lane-0-state;
		qcom,mdss-dsi-lane-1-state;
		qcom,mdss-dsi-lane-2-state;
		qcom,mdss-dsi-lane-3-state;
		qcom,mdss-dsi-panel-timings = [75 18 10 00 3A 3E 14 1A 13 03 04 00];
		qcom,mdss-dsi-t-clk-post = <0x2c>;
		qcom,mdss-dsi-t-clk-pre = <0x20>;
		qcom,mdss-dsi-bl-min-level = <1>;
		qcom,mdss-dsi-bl-max-level = <255>;
		qcom,mdss-dsi-dma-trigger = "trigger_sw";
		qcom,mdss-dsi-mdp-trigger = "none";
		qcom,mdss-dsi-bl-pmic-control-type = "bl_ctrl_pwm";
                //qcom,mdss-dsi-bl-pmic-control-type = "bl_ctrl_gp_clk";//add by YangRujin for gp_clk control bl.
		qcom,mdss-dsi-bl-pmic-pwm-frequency = <100>;
		qcom,mdss-dsi-bl-pmic-bank-select = <0>;
		qcom,mdss-dsi-pwm-gpio = <&pm8916_mpps 4 0>;
		//qcom,mdss-dsi-reset-sequence = <1 1>, <0 50>, <1 50>;
             qcom,mdss-dsi-lp11-init;
                //qcom,mdss-dsi-init-delay-us = <100>;
                qcom,mdss-dsi-reset-sequence = <1 20>, <0 20>, <1 50>;
                //qcom,mdss-dsi-hfp-power-mode;
                //qcom,mdss-dsi-hbp-power-mode;
                //qcom,mdss-dsi-hsa-power-mode;

	};
};

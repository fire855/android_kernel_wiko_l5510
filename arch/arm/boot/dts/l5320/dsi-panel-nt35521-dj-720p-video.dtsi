/* Copyright (c) 2014, The Linux Foundation. All rights reserved.
 *
 * This program is free software; you can redistribute it and/or modify
 * it under the terms of the GNU General Public License version 2 and
 * only version 2 as published by the Free Software Foundation.
 *
 * This program is distributed in the hope that it will be useful,
 * but WITHOUT ANY WARRANTY; without even the implied warranty of
 * MERCHANTABILITY or FITNESS FOR A PARTICULAR PURPOSE.  See the
 * GNU General Public License for more details.
 */

/*---------------------------------------------------------------------------
 * This file is autogenerated file using gcdb parser. Please do not edit it.
 * Update input XML file to add a new entry or update variable in this file
 * VERSION = "1.0"
 *---------------------------------------------------------------------------*/
&mdss_mdp {
	dsi_nt35521_dj_720p_video: qcom,mdss_dsi_nt35521_dj_720p_video {
		qcom,mdss-dsi-panel-name = "nt35521 dj 720p video mode dsi panel";
		qcom,mdss-dsi-panel-controller = <&mdss_dsi0>;
		qcom,mdss-dsi-panel-type = "dsi_video_mode";
		qcom,mdss-dsi-panel-destination = "display_1";
		qcom,mdss-dsi-panel-framerate = <60>;
		qcom,mdss-dsi-virtual-channel-id = <0>;
		qcom,mdss-dsi-stream = <0>;
		qcom,mdss-dsi-panel-width = <720>;
		qcom,mdss-dsi-panel-height = <1280>;
		qcom,mdss-dsi-h-front-porch = <44>;
		qcom,mdss-dsi-h-back-porch = <42>;
		qcom,mdss-dsi-h-pulse-width = <2>;
		qcom,mdss-dsi-h-sync-skew = <0>;
		qcom,mdss-dsi-v-back-porch = <14>;
		qcom,mdss-dsi-v-front-porch = <16>;
		qcom,mdss-dsi-v-pulse-width = <2>;
		qcom,mdss-dsi-h-left-border = <0>;
		qcom,mdss-dsi-h-right-border = <0>;
		qcom,mdss-dsi-v-top-border = <0>;
		qcom,mdss-dsi-v-bottom-border = <0>;
		qcom,mdss-dsi-bpp = <24>;
		qcom,mdss-dsi-color-order = "rgb_swap_rgb";
		qcom,mdss-dsi-underflow-color = <0xff>;
		qcom,mdss-dsi-border-color = <0>;
               //BEGIN <LCM> <DATE20150203> <add TE check for lcm eds check> limi.zhang 
               pinctrl-names = "te_active","te_suspend";
               pinctrl-0 = <&te_int_active>;
               pinctrl-1 = <&te_int_suspend>;
               interrupt-parent = <&msm_gpio>;
               interrupts = <0 24 1>;
               interrupt-names = "te_irq";
               qcom,irq-te = <&msm_gpio 24 0x00>; // delete or keep here
               qcom,mdss-dsi-TE-mode = "on"; // on  or  off  or  delete
               //END <LCM> <DATE20150203> <add TE check for lcm eds check> limi.zhang 

		qcom,mdss-dsi-on-command = [39 01 00 00 00 00 05 FF AA 55 A5 80
            39 01 00 00 00 00 02 F4 03
            39 01 00 00 00 00 06 F0 55 AA 52 08 00
            39 01 00 00 00 00 05 FF AA 55 A5 80
            39 01 00 00 00 00 03 6F 11 00
            39 01 00 00 00 00 03 F7 20 00
            39 01 00 00 00 00 02 6F 01
            39 01 00 00 00 00 02 B1 21
            39 01 00 00 00 00 06 BD 01 A0 10 08 01
            39 01 00 00 00 00 05 B8 01 02 0C 02
            39 01 00 00 00 00 03 BB 11 11
            39 01 00 00 00 00 03 BC 00 00
            39 01 00 00 00 00 02 B6 02
            39 01 00 00 00 00 06 F0 55 AA 52 08 01
            39 01 00 00 00 00 03 B0 09 09
            39 01 00 00 00 00 03 B1 09 09
            39 01 00 00 00 00 03 BC 88 00
            39 01 00 00 00 00 03 BD 8C 00
            39 01 00 00 00 00 02 CA 00
            39 01 00 00 00 00 02 C0 04
            39 01 00 00 00 00 03 B3 35 35
            39 01 00 00 00 00 03 B4 25 25
            39 01 00 00 00 00 03 B9 34 34
            39 01 00 00 00 00 03 BA 14 14
            39 01 00 00 00 00 06 F0 55 AA 52 08 02
            39 01 00 00 00 00 02 EE 01
            39 01 00 00 00 00 11 B0 00 00 00 19 00 3D 00 58 00 67 00 8A 00 AE 00 DE		
            39 01 00 00 00 00 11 B1 01 05 01 3F 01 6D 01 B6 01 F4 01 F6 02 2F 02 6C		
            39 01 00 00 00 00 11 B2 02 93 02 C6 02 E6 03 11 03 28 03 46 03 56 03 65		
            39 01 00 00 00 00 05 B3 03 6E 03 FF
            39 01 00 00 00 00 06 F0 55 AA 52 08 03
            39 01 00 00 00 00 03 B0 22 00
            39 01 00 00 00 00 03 B1 22 00
            39 01 00 00 00 00 06 B2 05 00 60 00 00
            39 01 00 00 00 00 06 B3 05 00 60 00 00
            39 01 00 00 00 00 06 B4 05 00 60 00 00
            39 01 00 00 00 00 06 B5 05 00 60 00 00                            
            39 01 00 00 00 00 06 BA 53 00 60 00 00
            39 01 00 00 00 00 06 BB 53 00 60 00 00
            39 01 00 00 00 00 06 BC 53 00 60 00 00
            39 01 00 00 00 00 06 BD 53 00 60 00 00
            39 01 00 00 00 00 05 C0 00 34 00 00
            39 01 00 00 00 00 05 C1 00 00 34 00
            39 01 00 00 00 00 05 C2 00 00 34 00
            39 01 00 00 00 00 05 C3 00 00 34 00
            39 01 00 00 00 00 02 C4 60
            39 01 00 00 00 00 02 C5 C0
            39 01 00 00 00 00 02 C6 00
            39 01 00 00 00 00 02 C7 00
            39 01 00 00 00 00 06 F0 55 AA 52 08 05
            39 01 00 00 00 00 03 B0 17 06
            39 01 00 00 00 00 03 B1 17 06
            39 01 00 00 00 00 03 B2 17 06
            39 01 00 00 00 00 03 B3 17 06
            39 01 00 00 00 00 03 B4 17 06
            39 01 00 00 00 00 03 B5 17 06
            39 01 00 00 00 00 03 B6 17 06
            39 01 00 00 00 00 03 B7 17 06
            39 01 00 00 00 00 02 B8 00
            39 01 00 00 00 00 03 B9 00 03
            39 01 00 00 00 00 03 BA 00 00
            39 01 00 00 00 00 03 BB 02 03
            39 01 00 00 00 00 03 BC 02 03
            39 01 00 00 00 00 06 BD 03 03 00 03 03
            39 01 00 00 00 00 02 C0 0B
            39 01 00 00 00 00 02 C1 09
            39 01 00 00 00 00 02 C2 A6
            39 01 00 00 00 00 02 C3 05
            39 01 00 00 00 00 02 C4 00
            39 01 00 00 00 00 02 C5 02
            39 01 00 00 00 00 02 C6 22
            39 01 00 00 00 00 02 C7 03
            39 01 00 00 00 00 03 C8 07 20
            39 01 00 00 00 00 03 C9 03 20
            39 01 00 00 00 00 03 CA 01 60
            39 01 00 00 00 00 03 CB 01 60
            39 01 00 00 00 00 04 CC 00 00 02
            39 01 00 00 00 00 04 CD 00 00 02
            39 01 00 00 00 00 04 CE 00 00 02
            39 01 00 00 00 00 04 CF 00 00 02
            39 01 00 00 00 00 06 D1 00 05 01 07 10
            39 01 00 00 00 00 06 D2 10 05 05 03 10
            39 01 00 00 00 00 06 D3 20 00 43 07 10
            39 01 00 00 00 00 06 D4 30 00 43 07 10
            39 01 00 00 00 00 08 D0 00 00 00 00 00 00 00
            39 01 00 00 00 00 0C D5 00 00 00 00 00 00 00 00 00 00 00
            39 01 00 00 00 00 0C D6 00 00 00 00 00 00 00 00 00 00 00
            39 01 00 00 00 00 0C D7 00 00 00 00 00 00 00 00 00 00 00
            39 01 00 00 00 00 06 D8 00 00 00 00 00
            39 01 00 00 00 00 02 E5 06
            39 01 00 00 00 00 02 E6 06
            39 01 00 00 00 00 02 E7 00
            39 01 00 00 00 00 02 E8 06
            39 01 00 00 00 00 02 E9 06
            39 01 00 00 00 00 02 EA 06
            39 01 00 00 00 00 02 EB 00
            39 01 00 00 00 00 02 EC 00
            39 01 00 00 00 00 02 ED 30     
            39 01 00 00 00 00 06 F0 55 AA 52 08 06
            39 01 00 00 00 00 03 B0 31 31
            39 01 00 00 00 00 03 B1 31 31
            39 01 00 00 00 00 03 B2 2D 2E
            39 01 00 00 00 00 03 B3 31 34
            39 01 00 00 00 00 03 B4 29 2A
            39 01 00 00 00 00 03 B5 12 10
            39 01 00 00 00 00 03 B6 18 16
            39 01 00 00 00 00 03 B7 00 02
            39 01 00 00 00 00 03 B8 08 31
            39 01 00 00 00 00 03 B9 31 31           
            39 01 00 00 00 00 03 BA 31 31  
            39 01 00 00 00 00 03 BB 31 08
            39 01 00 00 00 00 03 BC 03 01
            39 01 00 00 00 00 03 BD 17 19
            39 01 00 00 00 00 03 BE 11 13
            39 01 00 00 00 00 03 BF 2A 29
            39 01 00 00 00 00 03 C0 34 31
            39 01 00 00 00 00 03 C1 2E 2D
            39 01 00 00 00 00 03 C2 31 31
            39 01 00 00 00 00 03 C3 31 31           
            39 01 00 00 00 00 03 C4 31 31
            39 01 00 00 00 00 03 C5 31 31
            39 01 00 00 00 00 03 C6 2E 2D
            39 01 00 00 00 00 03 C7 31 34
            39 01 00 00 00 00 03 C8 29 2A
            39 01 00 00 00 00 03 C9 17 19
            39 01 00 00 00 00 03 CA 11 13
            39 01 00 00 00 00 03 CB 03 01
            39 01 00 00 00 00 03 CC 08 31 
            39 01 00 00 00 00 03 CD 31 31         
            39 01 00 00 00 00 03 CE 31 31   
            39 01 00 00 00 00 03 CF 31 08
            39 01 00 00 00 00 03 D0 00 02
            39 01 00 00 00 00 03 D1 12 10
            39 01 00 00 00 00 03 D2 18 16
            39 01 00 00 00 00 03 D3 2A 29
            39 01 00 00 00 00 03 D4 34 31
            39 01 00 00 00 00 03 D5 2D 2E
            39 01 00 00 00 00 03 D6 31 31
            39 01 00 00 00 00 03 D7 31 31          
            39 01 00 00 00 00 03 E5 31 31
            39 01 00 00 00 00 03 E6 31 31                                          
            39 01 00 00 00 00 06 D8 00 00 00 00 00
            39 01 00 00 00 00 06 D9 00 00 00 00 00
            39 01 00 00 00 00 02 E7 00
            39 01 00 00 00 00 02 6F 02
            39 01 00 00 00 00 02 F7 47
            39 01 00 00 00 00 02 6F 0A
            39 01 00 00 00 00 02 F7 02
            39 01 00 00 00 00 02 6F 17
            39 01 00 00 00 00 02 F4 60
            39 01 00 00 00 00 02 6F 01
            39 01 00 00 00 00 02 F9 46
            39 01 00 00 00 00 02 6F 11
            39 01 00 00 00 00 02 F3 01
            39 01 00 00 00 00 02 35 00
		    05 01 00 00 96 00 02 11 00
		    05 01 00 00 1E 00 02 29 00];
		qcom,mdss-dsi-off-command = [29 01 00 00 14 00 02 28 00
					29 01 00 00 78 00 02 10 00];
		qcom,mdss-dsi-on-command-state = "dsi_lp_mode";
		qcom,mdss-dsi-off-command-state = "dsi_hs_mode";

		//BEGIN <LCD> <DATE20141114> <ESD check> limi.zhang
		qcom,mdss-dsi-panel-status-command = [06 01 00 01 05 00 02 0A 08];
		//qcom,mdss-dsi-panel-status-command_two = [06 01 00 01 05 00 02 C0 08];
		qcom,mdss-dsi-panel-status-command-state = "dsi_hs_mode";
		qcom,mdss-dsi-panel-status-check-mode = "reg_read";
		//qcom,mdss-dsi-panel-status-read-mode = "two";
		qcom,mdss-dsi-panel-status-value = <0x9c>;
		//qcom,mdss-dsi-panel-status-value_two = <0x34>;
		//qcom,mdss-dsi-panel-status-check-mode = "bta_check";
		//END <LCD> <DATE20141114> <ESD check> limi.zhang

                qcom,esd-check-enabled;
		qcom,mdss-dsi-h-sync-pulse = <1>;
		qcom,mdss-dsi-traffic-mode = "burst_mode";
		qcom,mdss-dsi-lane-map = "lane_map_0123";
		qcom,mdss-dsi-bllp-eof-power-mode;
		qcom,mdss-dsi-bllp-power-mode;
		qcom,mdss-dsi-lane-0-state;
		qcom,mdss-dsi-lane-1-state;
		qcom,mdss-dsi-lane-2-state;
		qcom,mdss-dsi-lane-3-state;
		qcom,mdss-dsi-panel-timings = [75 18 10 00 3A 3E 14 1A 13 03 04 00];
		qcom,mdss-dsi-t-clk-post = <0x2c>;
		qcom,mdss-dsi-t-clk-pre = <0x20>;
		qcom,mdss-dsi-bl-min-level = <1>;
		qcom,mdss-dsi-bl-max-level = <255>;
		qcom,mdss-dsi-dma-trigger = "trigger_sw";
		qcom,mdss-dsi-mdp-trigger = "none";
		//LINE <lcm> <DATE20141027> <lcm bl ctrl> limi.zhang
		qcom,mdss-dsi-bl-pmic-control-type = "bl_ctrl_pwm";
		//qcom,mdss-dsi-bl-pmic-control-type = "bl_ctrl_gp_clk";
		qcom,mdss-dsi-bl-pmic-pwm-frequency=<30>;
		qcom,mdss-dsi-bl-pmic-bank-select = <0>;
		qcom,mdss-dsi-pwm-gpio = <&pm8916_mpps 4 0>;
		//qcom,mdss-dsi-reset-sequence = <1 1>, <0 50>, <1 50>;
                qcom,mdss-dsi-lp11-init; 
                //qcom,mdss-dsi-init-delay-us = <100>;
		qcom,mdss-dsi-reset-sequence = <1 2>, <0 20>, <1 120>;
                //qcom,mdss-dsi-hfp-power-mode;
                //qcom,mdss-dsi-hbp-power-mode;
                //qcom,mdss-dsi-hsa-power-mode;

	};
};
